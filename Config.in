## Config.in
```kconfig
source "$BR2_EXTERNAL_MEPA_PATH/package/mepa/Config.in"
source "$BR2_EXTERNAL_MEPA_PATH/package/mepa-spidev-proxy/Config.in"
```

## package/mepa-spidev-proxy/Config.in
```kconfig
config BR2_PACKAGE_MEPA_SPIDEV_PROXY
	bool "mepa-spidev-proxy"
	depends on BR2_TOOLCHAIN_HAS_THREADS
	depends on !BR2_STATIC_LIBS
	help
	  Userspace SPI arbitration daemon for the LAN80xx PHY family.

	  The daemon (lan80xx-spid) owns /dev/spidevX.Y exclusively and
	  exposes an AF_UNIX SOCK_SEQPACKET socket (default
	  /run/lan80xx-spid.sock) that serialises READ / WRITE / BATCH /
	  MAILBOX / CLAIM / RELEASE requests from clients such as mesa-cmd
	  and the ZLS userAppDemo. This replaces the historical mesa-demo
	  daemon as SPI owner.

	  Installs:
	    /usr/bin/lan80xx-spid          — arbitration daemon
	    /usr/bin/spiproxy-cli          — ad-hoc client
	    /usr/include/spi_proxy/spiproxy.h
	    /usr/lib/cmake/mepa_spidev_proxy/   (find_package integration)
	    /usr/lib/systemd/system/lan80xx-spid.service (systemd,
	      enabled by default)
	    /etc/init.d/S30lan80xx-spid (busybox or SysV init); the
	      board values come from /etc/default/lan80xx-spid
	      (SPIDEV, SPI_FREQ, SOCKET, RESET_LINE, DT_COMPATIBLE)

	  https://github.com/vjardin/mepa-spidev-proxy
```

## package/mepa_toolkit/Config.in
```kconfig
config BR2_PACKAGE_MEPA_TOOLKIT
	bool "mepa_toolkit"
	depends on BR2_PACKAGE_MEPA
	depends on BR2_PACKAGE_MEPA_LAN80XX_TS || BR2_PACKAGE_MEPA_LAN80XX_TS_MSEC
	depends on BR2_TOOLCHAIN_GCC_AT_LEAST_13
	depends on !BR2_STATIC_LIBS
	help
	  MEPA toolkit — a library subset that layers a spidev-based
	  bus driver and helpers on top of MEPA. Used by lan80xx_apps
	  (phy_init, phy_fw_update, ...) and downstream daemons.

	  https://gitlab.com/v_cz/mepa_toolkit
```
